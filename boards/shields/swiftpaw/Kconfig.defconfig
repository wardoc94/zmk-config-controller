## boards/shields/swiftpaw/Kconfig.defconfig
```kconfig
if SHIELD_SWIFTPAW_LEFT

config ZMK_KEYBOARD_NAME
    default "SwiftPaw"

config ZMK_SPLIT_ROLE_CENTRAL
    default y

endif # SHIELD_SWIFTPAW_LEFT

if SHIELD_SWIFTPAW_RIGHT

config ZMK_KEYBOARD_NAME
    default "SwiftPaw"

endif # SHIELD_SWIFTPAW_RIGHT

if SHIELD_SWIFTPAW_LEFT || SHIELD_SWIFTPAW_RIGHT

config ZMK_SPLIT
    default y

endif # SHIELD_SWIFTPAW_LEFT || SHIELD_SWIFTPAW_RIGHT

if SHIELD_SWIFTPAW_RIGHT_STANDALONE

config ZMK_KEYBOARD_NAME
    default "SwiftPaw Solo"

# Deliberately no ZMK_SPLIT default here - this shield is a full standalone
# keyboard by itself for testing the right half (matrix + PAW3395) without
# needing the left half paired.

endif # SHIELD_SWIFTPAW_RIGHT_STANDALONE
```

## boards/shields/swiftpaw/Kconfig.shield
```kconfig
config SHIELD_SWIFTPAW_LEFT
    def_bool $(shields_list_contains,swiftpaw_left)

config SHIELD_SWIFTPAW_RIGHT
    def_bool $(shields_list_contains,swiftpaw_right)
```

## config/west.yml
```yaml
manifest:
  remotes:
    - name: zmkfirmware
      url-base: https://github.com/zmkfirmware
    - name: badjeff
      url-base: https://github.com/badjeff
    - name: letmegobacktosleep
      url-base: https://github.com/letmegobacktosleep
  projects:
    - name: zmk
      remote: zmkfirmware
      revision: main
      import: app/west.yml
    - name: zmk-paw3395-driver
      remote: badjeff
      revision: main
    - name: zmk-keyboard-joystick-wasd
      remote: letmegobacktosleep
      revision: main
  self:
    path: config
```
