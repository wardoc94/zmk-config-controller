#include "swiftpaw.dtsi"
#include "swiftpaw_right_hw.dtsi"

/*
 * Right half is no longer symmetric with left: the two leftmost keys
 * on each of the bottom two rows were removed from the physical PCB.
 * That's already baked into the shared split_transform's map (see
 * swiftpaw.dtsi). This file just applies the col-offset that shifts
 * right's own raw columns 0-5 into the shared transform's global columns
 * 6-11, so its keys land on the correct (distinct from left's) keymap
 * positions instead of colliding with left's.
 */
&split_transform {
    col-offset = <6>;
};

/ {
    chosen {
        zmk,matrix-transform = &split_transform;
    };
};

/*
 * Right is now CENTRAL, co-located with the sensor - no relay needed
 * anymore, just listen directly (same as the standalone build does).
 */
/ {
    trackball_listener: trackball_listener {
        compatible = "zmk,input-listener";
        device = <&trackball>;
    };
};
